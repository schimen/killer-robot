## command_lib/zephyr/Kconfig
```kconfig
config COMMAND_LIB
	bool "Use command lib in project"

config COMMAND_UART
	bool "Use command lib with uart"

config COMMAND_GATT
	bool "Use command lib with gatt"
```

## dts/bindings/invensense,icm20948.yaml
```yaml
description: ICM20948 9-axis motion tracking device

compatible: "invensense,icm20948"

include: [sensor-device.yaml, spi-device.yaml]
```

## firmware/boards/xtensa/rupert_pcb/Kconfig.board
```kconfig
# Rupert PCB board configuration

config BOARD_RUPERT_PCB
	bool "Rupert PCB board"
	depends on SOC_ESP32
```

## firmware/boards/xtensa/rupert_pcb/Kconfig.defconfig
```kconfig
# Rupert PCB board configuration

config BOARD
	default "rupert_pcb"
	depends on BOARD_RUPERT_PCB

config ENTROPY_GENERATOR
	default y

config HEAP_MEM_POOL_SIZE
	default 98304 if WIFI
	default 40960 if BT
	default 4096

choice BT_HCI_BUS_TYPE
	default BT_ESP32 if BT
endchoice
```

## firmware/drivers/sensor/icm20948/Kconfig
```kconfig
config ICM20948
	bool "Custom ICM20948 sensor driver"
	default y
	depends on DT_HAS_INVENSENSE_ICM20948_ENABLED
	select SPI
	help
	  Enable ICM20948 SPI sensor

config ICM20948_DEBUG_SERVICE
	bool "Debug gatt service for ICM20948 raw data"
	default n
```

## firmware/dts/bindings/invensense,icm20948.yaml
```yaml
description: ICM20948 9-axis motion tracking device

compatible: "invensense,icm20948"

include: [base.yaml, sensor-device.yaml, spi-device.yaml]
```

## firmware/lib/command_lib/Kconfig
```kconfig
config COMMAND_LIB
	bool "Use command lib in project"

config COMMAND_UART
	bool "Use command lib with uart"
	default n

config COMMAND_GATT
	bool "Use command lib with gatt"
	default n
```

## firmware/transmitter/boards/teensy40.conf
```kconfig
# usb settings for teensy
CONFIG_USB_DEVICE_STACK=y
CONFIG_USB_DEVICE_PRODUCT="Killer robot transmitter"
```

## firmware/west.yml
```yaml
manifest:
  remotes:
    - name: zephyrproject-rtos
      url-base: https://github.com/zephyrproject-rtos

  projects:
    - name: zephyr
      remote: zephyrproject-rtos
      revision: v3.4.0
      import:
        name-allowlist:
          - hal_espressif
          - tinycrypt
```
